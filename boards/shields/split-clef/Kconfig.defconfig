## boards/shields/split-clef/Kconfig.defconfig
```kconfig
if SHIELD_SPLIT_CLEF_LEFT

# Name must be less than 16 characters long!
config ZMK_SPLIT_CLEF
    default "Split Clef"

config ZMK_SPLIT_ROLE_CENTRAL
    default y

endif

if SHIELD_SPLIT_CLEF_LEFT || SHIELD_SPLIT_CLEF_RIGHT

config ZMK_SPLIT
    default y

endif

if ZMK_DISPLAY

config I2C
    default y

config SSD1306
    default y

endif # ZMK_DISPLAY
```

## boards/shields/split-clef/Kconfig.shield
```kconfig
# No whitespace after the comma or in your part name!
config SHIELD_SPLIT_CLEF_LEFT
    def_bool $(shields_list_contains,split_clef_left)

# No whitespace after the comma or in your part name!
config SHIELD_SPLIT_CLEF_RIGHT
    def_bool $(shields_list_contains,split_clef_right)
```

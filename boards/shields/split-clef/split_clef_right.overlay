#include "split_clef.dtsi" // The shared dtsi file is included in the overlay

kscan0: kscan0 {
    input-gpios = 
        <&gpio1 15 (GPIO_ACTIVE_LOW | GPIO_PULL_UP)>,   /* KEY0  -> P1.15 */
        <&gpio1 13 (GPIO_ACTIVE_LOW | GPIO_PULL_UP)>,   /* KEY1  -> P1.13 */
        <&gpio1 11 (GPIO_ACTIVE_LOW | GPIO_PULL_UP)>,   /* KEY2  -> P1.11 */
        <&gpio0 10 (GPIO_ACTIVE_LOW | GPIO_PULL_UP)>,   /* KEY3  -> P0.10 */
        <&gpio0 9  (GPIO_ACTIVE_LOW | GPIO_PULL_UP)>,   /* KEY4  -> P0.09 */
        <&gpio1 4  (GPIO_ACTIVE_LOW | GPIO_PULL_UP)>,   /* KEY5  -> P0.06 */
        <&gpio1 6  (GPIO_ACTIVE_LOW | GPIO_PULL_UP)>,   /* KEY6  -> P0.08 */
        <&gpio0 29 (GPIO_ACTIVE_LOW | GPIO_PULL_UP)>,   /* KEY7  -> P0.17 */
        <&gpio1 15 (GPIO_ACTIVE_LOW | GPIO_PULL_UP)>,   /* KEY8  -> P0.22 */
        <&gpio1 11 (GPIO_ACTIVE_LOW | GPIO_PULL_UP)>,   /* KEY9  -> P0.24 */
        <&gpio1 10 (GPIO_ACTIVE_LOW | GPIO_PULL_UP)>,   /* KEY10 -> P1.00 */
        <&gpio0 9  (GPIO_ACTIVE_LOW | GPIO_PULL_UP)>;   /* KEY11 -> P0.11 */
};

&default_transform {
    col-offset = <12>;
};